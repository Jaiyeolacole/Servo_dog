## main/Kconfig
```kconfig
menu "Servo Dog WiFi Configuration"
    config ESP_WIFI_SSID
        string "WiFi SSID"
        default ""
        help
        WiFi SSID (network name) to connect to, or empty for Off.

    config ESP_WIFI_PASSWORD
        string "WiFi Password"
        default ""
        help
        WiFi Password if WEP/WPA/WPA2 or empty if Open.

    config ESP_WIFI_SOFTAP_SSID
        string "WiFi SoftAP SSID"
        default "ESP-Hi"
        help
        softAP SSID (network name) to create, or empty for Off.

    config ESP_WIFI_SOFTAP_PASSWORD
        string "WiFi softAP Password"
        default ""
        help
        softAP password for WPA2, or empty for Open.

    config ESP_WIFI_SOFTAP_MAX_STA
        int "Maximal STA connections"
        default 5

    config ESP_WIFI_AP_CHANNEL
        int "WiFi softAP Channel"
        default 1

    config SERVER_IP
        string "WiFi softAP IP Address"
        default "192.168.4.1"

    config ESP_MAXIMUM_RETRY
        int "Maximum retry"
        default 5
endmenu
```
